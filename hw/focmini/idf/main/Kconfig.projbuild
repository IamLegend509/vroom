## hw/focmini/idf/main/Kconfig.projbuild
```kconfig
menu "FOCMini motor setup"

config FOCMINI_BUS_MV
	int "Measured motor supply voltage (mV)"
	 range 0 30000
	 default 0
	 help
		Zero disarms the motor. Enter the measured supply voltage only after wiring review.

config FOCMINI_POLE_PAIRS
	int "Verified motor pole pairs"
	 range 0 64
	 default 0
	 help
		Zero disarms the motor. This is pole pairs, not the number of poles.

config FOCMINI_VOLTAGE_LIMIT_MV
	int "Initial motor voltage limit (mV)"
	 range 100 30000
	 default 500
	 help
		Start conservatively. This voltage-mode controller cannot enforce current.

config FOCMINI_VELOCITY_LIMIT_MRAD_S
	int "Velocity command limit (millirad/s)"
	 range 1 200000
	 default 20000
	 help
		Initial default is 20 rad/s (about 191 RPM), not a measured motor rating.

config FOCMINI_USE_AS5600
	bool "Use AS5600 closed-loop velocity mode"
	default n
	help
		Leave disabled for first open-loop bring-up. Enable only after encoder wiring and magnet alignment.

endmenu
```
